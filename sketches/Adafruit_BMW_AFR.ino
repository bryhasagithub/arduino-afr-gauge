/*********************************************************************
This is an example for our Monochrome OLEDs based on SSD1306 drivers

  Pick one up today in the adafruit shop!
  ------> http://www.adafruit.com/category/63_98

This example is for a 128x64 size display using I2C to communicate
3 pins are required to interface (2 I2C and one reset)

Adafruit invests time and resources providing this open source code, 
please support Adafruit and open-source hardware by purchasing 
products from Adafruit!

Written by Limor Fried/Ladyada  for Adafruit Industries.  
BSD license, check license.txt for more information
All text above, and the splash screen must be included in any redistribution
*********************************************************************/

#include <SPI.h>
#include <Wire.h>
#include <Adafruit_GFX.h>
#include <Adafruit_SSD1306.h>

#define OLED_RESET 4
Adafruit_SSD1306 display(OLED_RESET);

int XPOS = 0;
int YPOS = 0;
int analogIn = 0;
int val = 0;
int value = 0;
int x1 = 0;
int x2 = 0;
int x3 = 0;
int needle = 0;

#define BMW_Logo_HEIGHT 64
#define BMW_Logo_WIDTH 64
static const unsigned char PROGMEM BMW_Logo [] = {
0x00, 0x00, 0x00, 0x00, 0x00, 0x00, 0x00, 0x00, 0x00, 0x00, 0x00, 0x00, 0x00, 0x00, 0x00, 0x00,
0x00, 0x00, 0x00, 0x1F, 0xF0, 0x00, 0x00, 0x00, 0x00, 0x00, 0x01, 0xE0, 0x0F, 0x00, 0x00, 0x00,
0x00, 0x00, 0x0E, 0x03, 0x80, 0xE0, 0x00, 0x00, 0x00, 0x00, 0x30, 0xFF, 0xFE, 0x18, 0x00, 0x00,
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0x00, 0x00, 0x00, 0x00, 0x00, 0x00, 0x00, 0x00, 0x00, 0x00, 0x00, 0x00, 0x00, 0x00, 0x00, 0x00
};

#define R1100_GS_Logo_HEIGHT 24
#define R1100_GS_Logo_WIDTH 104
static const unsigned char PROGMEM R1100_GS_Logo [] = {
0x00, 0x00, 0x00, 0x00, 0x00, 0x00, 0x00, 0x00, 0x00, 0x00, 0x00, 0x00, 0x00, 0x00, 0x00, 0x00,
0x00, 0x00, 0x00, 0x00, 0x00, 0x00, 0x00, 0x00, 0x00, 0x01, 0x00, 0x00, 0x00, 0x00, 0x00, 0x00,
0x00, 0x00, 0x00, 0x06, 0x00, 0x00, 0x3F, 0x00, 0x00, 0x00, 0x00, 0x00, 0x00, 0x00, 0x00, 0x00,
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0x00, 0x00, 0x00, 0x00, 0x00, 0x00, 0x00, 0x00, 
};
  

#if (SSD1306_LCDHEIGHT != 64)
#error("Height incorrect, please fix Adafruit_SSD1306.h!");
#endif

void setup()   {                
  Serial.begin(9600);

  // by default, we'll generate the high voltage from the 3.3v line internally! (neat!)
  display.begin(SSD1306_SWITCHCAPVCC, 0x3c);  // initialize with the I2C addr 0x3D (for the 128x64)
  // init done

  // Clear the buffer.
  display.clearDisplay();
  startDisplay();
}


void loop() {
  val = analogRead(analogIn);
  needle = val;
  val = map(val, 0, 1023, 74, 221);
  needle = map(needle, 0, 1023, 1, 127);
  display.clearDisplay();
  display.drawRect(0, 52, 128, 12, WHITE);
  drawAFR();
  devide();
  display.setTextSize(3);
  display.setTextColor(WHITE);
  display.setCursor(32,0);
  display.print(x1);
  display.print(x2);
  display.print(".");
  display.print(x3);
  display.drawLine(needle, 53, needle, 63, WHITE);
  display.drawLine(needle-1, 53, needle-1, 63, WHITE);
  display.drawLine(needle+1, 53, needle+1, 63, WHITE);
  display.display();
  
}

void startDisplay() {
  display.clearDisplay();
  display.drawBitmap(32, 0, BMW_Logo, 64, 64, 1);
  display.display();
  delay(2000);
  XPOS = 12;
  YPOS = -25;
  while (YPOS != 20) {
    display.clearDisplay();
    display.drawBitmap(XPOS, YPOS, R1100_GS_Logo, 104, 24, 1);
    display.display();
    YPOS ++;
  }
  
    for (int x=0; x < 5; x++) {
    display.invertDisplay(true);
    delay(150);
    display.invertDisplay(false);
    delay(150);
  }
  display.invertDisplay(true);
  delay(2000);
  display.clearDisplay();
  display.display();
  display.invertDisplay(false);
}

void drawAFR() {
  display.drawLine(0,47,0,51,WHITE);
  display.drawLine(64,47,64,56,WHITE);
  display.drawLine(127,47,127,51,WHITE);
  display.setTextSize(1);
  display.setTextColor(WHITE);
  display.setCursor(54,34);
  display.println("14.7");
  display.setCursor(0,34);
  display.println("7.4");
  display.setCursor(104,34);
  display.println("22.1");
  
}

void devide() {
  x1 = 0;
  x2 = 0;
  x3 = 0;
  value = val;
  if (value < 100) goto dozens;
  if (value < 10) goto units;
hundreds:
  value = value - 100;
  x1 = x1 ++;
  if (value < 100) goto dozens;
  goto hundreds;
dozens:
  if (value < 10) goto units;
  value = value - 10;
  x2 = x2 ++;
  if (value < 10) goto units;
  goto dozens;
units:
  if (value < 1) goto devide_end;
  value = value - 1;
  x3 = x3 ++;
  if (value < 0) goto devide_end;
  goto units;
devide_end:
  x1 = x1;
}

  
  
